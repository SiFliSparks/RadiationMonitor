## project/Kconfig.tmp
```kconfig
source "D:/OpenSiFli/sifli-sdk/customer/boards/sf32lb52-lchspi-ulp/hcpu/Kconfig.board"
source "$SIFLI_SDK/customer/boards/Kconfig.v2"
source "$SIFLI_SDK/Kconfig.v2"
rsource "Kconfig.proj"
```

## project/build_sf32lb52-lchspi-ulp_hcpu/Kconfig
```kconfig
source "$SIFLI_SDK/Kconfig.v2"
source "$SIFLI_SDK/customer/boards/Kconfig.v2"
source "C:/Users/xuzhi/sifli/SiFli-SDK/v2.4.1/customer/boards/sf32lb52-lchspi-ulp/hcpu/Kconfig.board"
source "D:/OpenSiFli/Project/RadiationMonitor/project/Kconfig.proj"
```

## project/build_sf32lb52-lchspi-ulp_hcpu/bootloader/Kconfig
```kconfig
source "$SIFLI_SDK/Kconfig.v2"
source "$SIFLI_SDK/customer/boards/Kconfig.v2"
source "C:/Users/xuzhi/sifli/SiFli-SDK/v2.4.1/customer/boards/sf32lb52-lchspi-ulp/hcpu/Kconfig.board"
source "C:/Users/xuzhi/sifli/SiFli-SDK/v2.4.1/example/boot_loader/project/butterflmicro/ram_v2/Kconfig.proj"
```

## project/build_sf32lb52-lchspi-ulp_hcpu/ftab/Kconfig
```kconfig
source "$SIFLI_SDK/Kconfig.v2"
source "$SIFLI_SDK/customer/boards/Kconfig.v2"
source "D:/OpenSiFli/sifli-sdk/customer/boards/sf32lb52-lchspi-ulp/hcpu/Kconfig.board"
source "C:/Users/xuzhi/sifli/SiFli-SDK/v2.4.1/example/flash_table/sf32lb52x_common_v2/Kconfig.proj"
```
